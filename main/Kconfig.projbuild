## main/Kconfig.projbuild
```kconfig
menu "Multicast Configuration"
    config MULTICAST_ADDR
        string "Multicast IPV4 Address (send & receive)"
        default "232.10.11.12"
        help
            IPV4 multicast address to both send to and listen to.

    config MULTICAST_PORT
        int "Multicast port (send & receive)"
        range 0 65535
        default 3333
        help
            Multicast port to both send & receive UDP packets on.

    config MULTICAST_TTL
        int  "Multicast packet TTL"
        range 1 255
        help
            Sets TTL field of multicast packets. Separate from uni- & broadcast TTL.

endmenu
```
